## buildEnv/openwrt-imagebuilder-23.05.2-ramips-mt7621.Linux-x86_64/build_dir/target-mipsel_24kc_musl/linux-ramips_mt7621/h3c_tx1801-plus-kernel.bin.its
```
/dts-v1/;

/ {
	description = "MIPS OpenWrt FIT (Flattened Image Tree)";
	#address-cells = <1>;

	images {
		kernel-1 {
			description = "MIPS OpenWrt Linux-5.15.137";
			data = /incbin/("/builder/shared-workdir/build/build_dir/target-mipsel_24kc_musl/linux-ramips_mt7621/h3c_tx1801-plus-kernel.bin");
			type = "kernel";
			arch = "mips";
			os = "linux";
			compression = "lzma";
			load = <0x82000000>;
			entry = <0x82000000>;
			hash-1 {
				algo = "crc32";
			};
			hash-2 {
				algo = "sha1";
			};
		};


		fdt-1 {
			description = "MIPS OpenWrt h3c_tx1801-plus device tree blob";
			
			data = /incbin/("/builder/shared-workdir/build/build_dir/target-mipsel_24kc_musl/linux-ramips_mt7621/image-mt7621_h3c_tx1801-plus.dtb");
			type = "flat_dt";
			
			arch = "mips";
			compression = "none";
			hash-1 {
				algo = "crc32";
			};
			hash-2 {
				algo = "sha1";
			};
		};



	};

	configurations {
		default = "config-1";
		config-1 {
			description = "OpenWrt h3c_tx1801-plus";
			kernel = "kernel-1";
			fdt = "fdt-1";
			
			
			
		};
		
	};
};
```

## buildEnv/openwrt-imagebuilder-23.05.2-ramips-mt7621.Linux-x86_64/build_dir/target-mipsel_24kc_musl/linux-ramips_mt7621/iptime_ax2004m-kernel.bin.its
```
/dts-v1/;

/ {
	description = "MIPS OpenWrt FIT (Flattened Image Tree)";
	#address-cells = <1>;

	images {
		kernel-1 {
			description = "MIPS OpenWrt Linux-5.15.137";
			data = /incbin/("/builder/shared-workdir/build/build_dir/target-mipsel_24kc_musl/linux-ramips_mt7621/iptime_ax2004m-kernel.bin");
			type = "kernel";
			arch = "mips";
			os = "linux";
			compression = "lzma";
			load = <0x82000000>;
			entry = <0x82000000>;
			hash-1 {
				algo = "crc32";
			};
			hash-2 {
				algo = "sha1";
			};
		};


		fdt-1 {
			description = "MIPS OpenWrt iptime_ax2004m device tree blob";
			
			data = /incbin/("/builder/shared-workdir/build/build_dir/target-mipsel_24kc_musl/linux-ramips_mt7621/image-mt7621_iptime_ax2004m.dtb");
			type = "flat_dt";
			
			arch = "mips";
			compression = "none";
			hash-1 {
				algo = "crc32";
			};
			hash-2 {
				algo = "sha1";
			};
		};



	};

	configurations {
		default = "config-1";
		config-1 {
			description = "OpenWrt iptime_ax2004m";
			kernel = "kernel-1";
			fdt = "fdt-1";
			
			
			
		};
		
	};
};
```

## buildEnv/openwrt-imagebuilder-23.05.2-ramips-mt7621.Linux-x86_64/build_dir/target-mipsel_24kc_musl/linux-ramips_mt7621/ubnt_unifi-6-lite-kernel.bin.its
```
/dts-v1/;

/ {
	description = "MIPS OpenWrt FIT (Flattened Image Tree)";
	#address-cells = <1>;

	images {
		kernel-1 {
			description = "MIPS OpenWrt Linux-5.15.137";
			data = /incbin/("/builder/shared-workdir/build/build_dir/target-mipsel_24kc_musl/linux-ramips_mt7621/ubnt_unifi-6-lite-kernel.bin");
			type = "kernel";
			arch = "mips";
			os = "linux";
			compression = "lzma";
			load = <0x80001000>;
			entry = <0x80001000>;
			hash-1 {
				algo = "crc32";
			};
			hash-2 {
				algo = "sha1";
			};
		};


		fdt-1 {
			description = "MIPS OpenWrt ubnt_unifi-6-lite device tree blob";
			
			data = /incbin/("/builder/shared-workdir/build/build_dir/target-mipsel_24kc_musl/linux-ramips_mt7621/image-mt7621_ubnt_unifi-6-lite.dtb");
			type = "flat_dt";
			load = <0x87000000>;
			arch = "mips";
			compression = "none";
			hash-1 {
				algo = "crc32";
			};
			hash-2 {
				algo = "sha1";
			};
		};



	};

	configurations {
		default = "config@1";
		config@1 {
			description = "OpenWrt ubnt_unifi-6-lite";
			kernel = "kernel-1";
			fdt = "fdt-1";
			
			
			
		};
		
	};
};
```

## buildEnv/openwrt-imagebuilder-23.05.2-ramips-mt7621.Linux-x86_64/build_dir/target-mipsel_24kc_musl/linux-ramips_mt7621/wavlink_ws-wn572hp3-4g-kernel.bin.its
```
/dts-v1/;

/ {
	description = "MIPS OpenWrt FIT (Flattened Image Tree)";
	#address-cells = <1>;

	images {
		kernel-1 {
			description = "MIPS OpenWrt Linux-5.15.137";
			data = /incbin/("/builder/shared-workdir/build/build_dir/target-mipsel_24kc_musl/linux-ramips_mt7621/wavlink_ws-wn572hp3-4g-kernel.bin");
			type = "kernel";
			arch = "mips";
			os = "linux";
			compression = "lzma";
			load = <0x82000000>;
			entry = <0x82000000>;
			hash-1 {
				algo = "crc32";
			};
			hash-2 {
				algo = "sha1";
			};
		};


		fdt-1 {
			description = "MIPS OpenWrt wavlink_ws-wn572hp3-4g device tree blob";
			
			data = /incbin/("/builder/shared-workdir/build/build_dir/target-mipsel_24kc_musl/linux-ramips_mt7621/image-mt7621_wavlink_ws-wn572hp3-4g.dtb");
			type = "flat_dt";
			
			arch = "mips";
			compression = "none";
			hash-1 {
				algo = "crc32";
			};
			hash-2 {
				algo = "sha1";
			};
		};



	};

	configurations {
		default = "config-1";
		config-1 {
			description = "OpenWrt wavlink_ws-wn572hp3-4g";
			kernel = "kernel-1";
			fdt = "fdt-1";
			
			
			
		};
		
	};
};
```

## buildEnv/openwrt-imagebuilder-23.05.2-ramips-mt7621.Linux-x86_64/build_dir/target-mipsel_24kc_musl/linux-ramips_mt7621/zyxel_nwa50ax-kernel.bin.its
```
/dts-v1/;

/ {
	description = "MIPS OpenWrt FIT (Flattened Image Tree)";
	#address-cells = <1>;

	images {
		kernel-1 {
			description = "MIPS OpenWrt Linux-5.15.137";
			data = /incbin/("/builder/shared-workdir/build/build_dir/target-mipsel_24kc_musl/linux-ramips_mt7621/zyxel_nwa50ax-kernel.bin");
			type = "kernel";
			arch = "mips";
			os = "linux";
			compression = "lzma";
			load = <0x80001000>;
			entry = <0x80001000>;
			hash-1 {
				algo = "crc32";
			};
			hash-2 {
				algo = "sha1";
			};
		};


		fdt-1 {
			description = "MIPS OpenWrt zyxel_nwa50ax device tree blob";
			
			data = /incbin/("/builder/shared-workdir/build/build_dir/target-mipsel_24kc_musl/linux-ramips_mt7621/image-mt7621_zyxel_nwa50ax.dtb");
			type = "flat_dt";
			
			arch = "mips";
			compression = "none";
			hash-1 {
				algo = "crc32";
			};
			hash-2 {
				algo = "sha1";
			};
		};



	};

	configurations {
		default = "config-1";
		config-1 {
			description = "OpenWrt zyxel_nwa50ax";
			kernel = "kernel-1";
			fdt = "fdt-1";
			
			
			
		};
		
	};
};
```

## buildEnv/openwrt-imagebuilder-23.05.2-rockchip-armv8.Linux-x86_64/build_dir/target-aarch64_generic_musl/linux-rockchip_armv8/firefly_roc-rk3328-cc-kernel.bin.its
```
/dts-v1/;

/ {
	description = "ARM64 OpenWrt FIT (Flattened Image Tree)";
	#address-cells = <1>;

	images {
		kernel-1 {
			description = "ARM64 OpenWrt Linux-5.15.137";
			data = /incbin/("/builder/shared-workdir/build/build_dir/target-aarch64_generic_musl/linux-rockchip_armv8/firefly_roc-rk3328-cc-kernel.bin");
			type = "kernel";
			arch = "arm64";
			os = "linux";
			compression = "lzma";
			load = <0x03200000>;
			entry = <0x03200000>;
			hash-1 {
				algo = "crc32";
			};
			hash-2 {
				algo = "sha1";
			};
		};


		fdt-1 {
			description = "ARM64 OpenWrt firefly_roc-rk3328-cc device tree blob";
			
			data = /incbin/("/builder/shared-workdir/build/build_dir/target-aarch64_generic_musl/linux-rockchip_armv8/linux-5.15.137/arch/arm64/boot/dts/rockchip/rk3328-roc-cc.dtb");
			type = "flat_dt";
			
			arch = "arm64";
			compression = "none";
			hash-1 {
				algo = "crc32";
			};
			hash-2 {
				algo = "sha1";
			};
		};



	};

	configurations {
		default = "config-1";
		config-1 {
			description = "OpenWrt firefly_roc-rk3328-cc";
			kernel = "kernel-1";
			fdt = "fdt-1";
			
			
			
		};
		
	};
};
```

## buildEnv/openwrt-imagebuilder-23.05.2-rockchip-armv8.Linux-x86_64/build_dir/target-aarch64_generic_musl/linux-rockchip_armv8/friendlyarm_nanopi-r4s-kernel.bin.its
```
/dts-v1/;

/ {
	description = "ARM64 OpenWrt FIT (Flattened Image Tree)";
	#address-cells = <1>;

	images {
		kernel-1 {
			description = "ARM64 OpenWrt Linux-5.15.137";
			data = /incbin/("/builder/shared-workdir/build/build_dir/target-aarch64_generic_musl/linux-rockchip_armv8/friendlyarm_nanopi-r4s-kernel.bin");
			type = "kernel";
			arch = "arm64";
			os = "linux";
			compression = "lzma";
			load = <0x03200000>;
			entry = <0x03200000>;
			hash-1 {
				algo = "crc32";
			};
			hash-2 {
				algo = "sha1";
			};
		};


		fdt-1 {
			description = "ARM64 OpenWrt friendlyarm_nanopi-r4s device tree blob";
			
			data = /incbin/("/builder/shared-workdir/build/build_dir/target-aarch64_generic_musl/linux-rockchip_armv8/linux-5.15.137/arch/arm64/boot/dts/rockchip/rk3399-nanopi-r4s.dtb");
			type = "flat_dt";
			
			arch = "arm64";
			compression = "none";
			hash-1 {
				algo = "crc32";
			};
			hash-2 {
				algo = "sha1";
			};
		};



	};

	configurations {
		default = "config-1";
		config-1 {
			description = "OpenWrt friendlyarm_nanopi-r4s";
			kernel = "kernel-1";
			fdt = "fdt-1";
			
			
			
		};
		
	};
};
```

## buildEnv/openwrt-imagebuilder-23.05.2-rockchip-armv8.Linux-x86_64/build_dir/target-aarch64_generic_musl/linux-rockchip_armv8/xunlong_orangepi-r1-plus-lts-kernel.bin.its
```
/dts-v1/;

/ {
	description = "ARM64 OpenWrt FIT (Flattened Image Tree)";
	#address-cells = <1>;

	images {
		kernel-1 {
			description = "ARM64 OpenWrt Linux-5.15.137";
			data = /incbin/("/builder/shared-workdir/build/build_dir/target-aarch64_generic_musl/linux-rockchip_armv8/xunlong_orangepi-r1-plus-lts-kernel.bin");
			type = "kernel";
			arch = "arm64";
			os = "linux";
			compression = "lzma";
			load = <0x03200000>;
			entry = <0x03200000>;
			hash-1 {
				algo = "crc32";
			};
			hash-2 {
				algo = "sha1";
			};
		};


		fdt-1 {
			description = "ARM64 OpenWrt xunlong_orangepi-r1-plus-lts device tree blob";
			
			data = /incbin/("/builder/shared-workdir/build/build_dir/target-aarch64_generic_musl/linux-rockchip_armv8/linux-5.15.137/arch/arm64/boot/dts/rockchip/rk3328-orangepi-r1-plus-lts.dtb");
			type = "flat_dt";
			
			arch = "arm64";
			compression = "none";
			hash-1 {
				algo = "crc32";
			};
			hash-2 {
				algo = "sha1";
			};
		};



	};

	configurations {
		default = "config-1";
		config-1 {
			description = "OpenWrt xunlong_orangepi-r1-plus-lts";
			kernel = "kernel-1";
			fdt = "fdt-1";
			
			
			
		};
		
	};
};
```
